## sdkconfig.defaults
```kconfig
CONFIG_ESP_MAIN_TASK_STACK_SIZE=20000
CONFIG_ESP_SYSTEM_EVENT_TASK_STACK_SIZE=8192
CONFIG_PTHREAD_TASK_STACK_SIZE_DEFAULT=8192
CONFIG_TASK_WDT=n

# Workaround for https://github.com/espressif/esp-idf/issues/7631
CONFIG_MBEDTLS_CERTIFICATE_BUNDLE=n
CONFIG_MBEDTLS_CERTIFICATE_BUNDLE_DEFAULT_FULL=n

# Workaround for the experimental HTTP(S) TLS client demo
CONFIG_ESP_TLS_INSECURE=y
CONFIG_ESP_TLS_SKIP_SERVER_CERT_VERIFY=y

# Stuff I added
CONFIG_PARTITION_TABLE_SINGLE_APP_LARGE=y
CONFIG_LOG_MAXIMUM_LEVEL_DEBUG=y # Don't change this
CONFIG_LOG_DEFAULT_LEVEL_INFO=y # Adjust this as needed

# Enable websockets
CONFIG_HTTPD_WS_SUPPORT=y

# Enable HTTPS
CONFIG_ESP_HTTPS_SERVER_ENABLE=y

# Bluetooth
CONFIG_BT_ENABLED=y
CONFIG_BT_BLUEDROID_ENABLED=y
CONFIG_BT_CLASSIC_ENABLED=n
CONFIG_BTDM_CTRL_MODE_BLE_ONLY=y
CONFIG_BTDM_CTRL_MODE_BR_EDR_ONLY=n
CONFIG_BTDM_CTRL_MODE_BTDM=n
CONFIG_BT_BLE_42_FEATURES_SUPPORTED=y
CONFIG_BT_BLE_50_FEATURES_SUPPORTED=n
CONFIG_BT_BTC_TASK_STACK_SIZE=20000
CONFIG_BT_BLE_DYNAMIC_ENV_MEMORY=y
```
